## config/west.yml
```yaml
manifest:
  remotes:
    - name: zmkfirmware
      url-base: https://github.com/zmkfirmware
    - name: krikun98
      url-base: https://github.com/krikun98
    - name: ftc
      url-base: https://github.com/ftc
    - name: nickconway
      url-base: https://github.com/nickconway
    - name: sixzero
      url-base: https://github.com/Sixzero
  # projects:
  #   - name: zmk
  #     remote: sixzero
  #     revision: dev_six
  #     import: app/west.yml
  projects:
    - name: zmk
      remote: nickconway
      revision: dev
      import: app/west.yml
  self:
    path: config
```
